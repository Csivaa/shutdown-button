/*
 * button_shutdown.ino
 * ============================================================
 * Arduino Uno: тактовая кнопка на макетной плате (breadboard).
 * При нажатии кнопки плата отправляет в Serial строку "PRESS",
 * которую читает Python-скрипт на компьютере (shutdown_listener.py).
 *
 * ПОДКЛЮЧЕНИЕ (внешний резистор НЕ нужен — используется
 * встроенная подтяжка INPUT_PULLUP):
 *
 *   ПИТАНИЕ: отдельное питание на макетную плату НЕ подаётся.
 *   Arduino питается от USB. Красная линия («+», 5V) на макетке
 *   в этой схеме НЕ используется вообще. Кнопка лишь замыкает
 *   два провода, поэтому вся схема — 2 провода напрямую к Arduino.
 *   НИКОГДА не соединяйте 5V (красная линия) с GND (синяя линия)
 *   через кнопку — это короткое замыкание!
 *
 *   КОД ОДИНАКОВ ДЛЯ КНОПКИ С 2, 3 И 4 НОЖКАМИ —
 *   все они при нажатии просто замыкают два контакта.
 *   Главное правило: один провод -> GND, второй -> D2.
 *
 *   Ножек 2: вставьте кнопку в два РАЗНЫХ ряда макетной
 *      платы (через центральную канавку). Провод 1 — от ряда
 *      с первой ножкой -> GND. Провод 2 — от ряда со второй
 *      ножкой -> D2.
 *   Ножек 3: две ножки соединены постоянно, третья замыкается
 *      при нажатии. Провод 1 -> крайняя ножка -> GND,
 *      провод 2 -> средняя ножка -> D2. Если `PRESS` появляется
 *      без нажатия — переставьте провод на другую крайнюю ножку.
 *   Ножек 4: вставляется поперёк центральной канавки.
 *      ВНИМАНИЕ! Две ножки с ОДНОЙ стороны соединены между
 *      собой. Провод 1 -> ножка стороны A -> GND,
 *      провод 2 -> ножка ПРОТИВОПОЛОЖНОЙ стороны B -> D2.
 *
 *   Пока кнопка отпущена, D2 подтянут к +5В и читается как HIGH.
 *   При нажатии D2 замыкается на GND и читается как LOW.
 *
 *   Если подключить оба провода к одной стороне (или к одной
 *   ножке) кнопки, цепь окажется замкнутой всегда и Python
 *   выключит компьютер сразу после запуска — так делать нельзя!
 * ============================================================
 */

const int BUTTON_PIN = 2;               // вывод, к которому подключена кнопка (D2)
const unsigned long DEBOUNCE_MS = 50;   // подавление дребезга контактов, мс
const unsigned long REPEAT_GUARD_MS = 3000; // пауза между отправками команд, мс

unsigned long lastPressTime = 0;

void setup() {
  pinMode(BUTTON_PIN, INPUT_PULLUP);    // встроенная подтяжка к +5В
  pinMode(LED_BUILTIN, OUTPUT);         // светодиод на плате (для индикации)
  Serial.begin(9600);                   // скорость должна совпадать с Python-скриптом
}

void loop() {
  static bool lastButtonState = HIGH;   // кнопка отпущена (подтянута к +5В)
  bool buttonState = digitalRead(BUTTON_PIN);

  // Антидребезг: если состояние изменилось, ждём и перечитываем
  if (buttonState != lastButtonState) {
    delay(DEBOUNCE_MS);
    buttonState = digitalRead(BUTTON_PIN);
  }

  // Кнопка нажата: состояние стало LOW (замкнута на GND)
  if (buttonState == LOW && lastButtonState == HIGH) {
    unsigned long now = millis();
    if (now - lastPressTime > REPEAT_GUARD_MS) {  // защита от повторной отправки
      digitalWrite(LED_BUILTIN, HIGH);            // короткая вспышка светодиода
      Serial.println("PRESS");                    // именно эту строку ждёт Python
      delay(100);
      digitalWrite(LED_BUILTIN, LOW);
      lastPressTime = now;
    }
  }

  lastButtonState = buttonState;
}
